## config/west.yml
```yaml
manifest:
  defaults:
    revision: v0.3
  remotes:
    - name: zmkfirmware
      url-base: https://github.com/zmkfirmware
    - name: awkannan
      url-base: https://github.com/awkannan
    # Additional modules containing boards/shields/custom code can be listed here as well
    # See https://docs.zephyrproject.org/3.2.0/develop/west/manifest.html#projects
  projects:
    - name: zmk
      remote: zmkfirmware
      import: app/west.yml
    - name: zmk-cannonkeys-keyboards
      url: https://github.com/cannonkeys/zmk-cannonkeys-keyboards
      revision: main
      path: modules/zmk-cannonkeys-keyboards
    - name: zmk-gpio-behavior
      remote: awkannan
      revision: main
    - name: zmk-smart-rgbled-widget
      remote: awkannan
      revision: main
  self:
    path: config
```
